## sm8550-modules/oplus/kernel/leds/aw210xx/Kconfig
```kconfig
config LEDS_AW210XX
	tristate "Awinic AW210XX LED controller"
	depends on I2C && LEDS_CLASS && OF
	help
	  Driver for the Awinic AW21018 / AW21024 / AW21036 I2C LED
	  controller used for RGB notification LEDs.

	  Used in OnePlus 11 for the notification/status LED.

	  To compile as a module, choose M here.
```

## sm8550-modules/oplus/kernel/tri_state_key/Kconfig
```kconfig
config OPLUS_TRIKEY_MAIN
	tristate "OnePlus tri-state alert slider"
	depends on GPIOLIB && OF && EXTCON
	help
	  Driver for the OnePlus three-position alert slider found on
	  OnePlus 7 Pro, 8 Pro, 9 Pro, 10 Pro, 11, and variants.

	  Uses two GPIO inputs from hall-effect position sensors to detect
	  ring / vibrate / silent slider positions, reported via extcon.

	  To compile as a module, choose M here.
```

## sm8550-modules/oplus/kernel/vibrator/aw8697_haptic/Kconfig
```kconfig
config AW8697_HAPTIC
	tristate "Awinic AW8697 haptic motor driver"
	depends on I2C && INPUT && OF
	select INPUT_FF_MEMLESS
	help
	  Driver for the Awinic AW8697 linear resonant actuator (LRA)
	  and eccentric rotating mass (ERM) haptic motor controller.

	  Used in OnePlus 11 for vibration feedback.
	  Communicates over I2C, loads haptic waveforms from firmware.

	  To compile as a module, choose M here.

config HAPTIC_FEEDBACK
	tristate "Haptic feedback framework (OPLUS)"
	depends on AW8697_HAPTIC
	help
	  OnePlus haptic feedback framework that sits above the AW8697
	  driver and provides per-effect waveform selection.

	  To compile as a module, choose M here.
```
